## mesh_node/main/Kconfig.projbuild
```kconfig
menu "KeyGrid Node Config"
    config KG_ROOM_ID
        int "Room/Zone ID"
        default 2
    config KG_SEND_PERIOD_MS
        int "Send period (ms)"
        default 2000
    config KG_ACK_TIMEOUT_MS
        int "ACK timeout (ms)"
        default 300
    config KG_ACK_RETRIES
        int "ACK retries"
        default 3
endmenu
```

## mesh_root/main/Kconfig.projbuild
```kconfig
menu "KeyGrid Root Config"

config KG_PRINT_HEX
    bool "Hex dump payloads"
    default y

endmenu
```

## mesh_root/main/sdkconfig.defaults
```kconfig
CONFIG_ESP32S3_DEFAULT_CPU_FREQ_240=y
CONFIG_COMPILER_OPTIMIZATION_SIZE=y
CONFIG_MESH_ENABLED=y
CONFIG_COMPILER_WARNINGS_AS_ERRORS=n
```
